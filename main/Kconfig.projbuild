## main/Kconfig.projbuild
```kconfig
# Adds a "Weather Display" menu to `idf.py menuconfig`.
# Values chosen here end up in sdkconfig and are available in C as CONFIG_<NAME>.

menu "Wi-Fi"
    # The option names still say WEATHER_ (they started out in the weather menu); keeping
    # them means an existing sdkconfig keeps its Wi-Fi settings.

    config WEATHER_WIFI_SSID
        string "Wi-Fi network name (SSID)"
        default ""
        help
            Name of the 2.4 GHz Wi-Fi network to join. The ESP32-S3 cannot use 5 GHz.

    config WEATHER_WIFI_PASSWORD
        string "Wi-Fi password"
        default ""
        help
            Password for the network above. Leave empty for an open network.

endmenu

menu "Chinese Story"

    config STORY_API_KEY
        string "Claude API key"
        default ""
        help
            Anthropic API key (from platform.claude.com) used to write the daily story.
            Stored in plain text in sdkconfig and the firmware, so don't share either.

    config STORY_MODEL
        string "Claude model"
        default "claude-opus-5-5"
        help
            Model that writes the story. One request per day.

    config STORY_HSK_LEVEL
        int "Reader level (HSK 1-6)"
        range 1 6
        default 3
        help
            Vocabulary the story may assume you know, on top of the words earlier
            stories introduced.

    config STORY_RESET_HOUR
        int "Hour a new story starts (0-23, local time)"
        range 0 23
        default 3
        help
            The story changes at this hour each night. The board writes the next
            story shortly after, so it's ready in the morning.

endmenu

menu "Hardware"

    config DISPLAY_ROTATE_180
        bool "Rotate the display 180 degrees"
        default n
        help
            The default matches Waveshare's examples for the ESP32-S3-LR1121-ePaper-2.9.
            This is only the starting value: the Settings app's "Rotate" row changes it
            on the device and remembers its choice.

    config DISPLAY_DIAGNOSTIC
        bool "Run the display wiring diagnostic at every boot"
        default n
        help
            Before starting, test the display pins (pull-up/down survey, shorts between
            pins, whether the panel responds to reset and commands) and log a report under
            the tag "epd_diag". Adds about 20 s to start-up. Use it when bringing up new
            wiring; see components/display/README.md.

    config DISPLAY_FAST_REFRESH
        bool "Fast full refresh for black/white screens"
        default y
        help
            Full refreshes use the controller's short waveform (about half the time of
            the normal one, with less flashing). It clears ghosting less thoroughly, so
            every 10th full refresh is still the normal one. Screens with grey (album
            art) always use the grey waveform. Turn off if images look washed out in
            the cold.

    config DISPLAY_PICTURE_GAMMA
        int "Picture brightness: gamma x 100 (lower = lighter), the default"
        range 30 100
        default 75
        help
            Pictures (album art, book pictures, the off screen photo) are lightened
            before they're dithered to the panel's 4 greys: each pixel becomes
            255 x (value / 255) ^ (this / 100). The panel's two greys look darker than
            their nominal levels, so without it (100) pictures come out too dark.
            Lower values lift the mid-tones more; black and white stay as they are.
            Only the default: Settings > Darkness changes it on the device.

    config BUTTONS_SERIAL_KEYS
        bool "Accept keyboard presses over USB serial as button presses (testing)"
        default y
        help
            For testing before the controls are wired: keys typed into `idf.py monitor`
            (or any serial terminal on the USB port) act as the buttons.
              Left arrow / a   = left      A = left hold
              Right arrow / d  = right     D = right hold
              Enter / space    = select    S, or hold Enter = select hold
              Backspace / b    = back      h = home
              , or [ or <      = left hold (previous track), no left press first
              . or ] or >      = right hold (next track)
            Turn off once the real buttons are soldered.

endmenu
```
